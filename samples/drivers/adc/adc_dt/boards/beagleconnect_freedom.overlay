/*
 * SPDX-License-Identifier: Apache-2.0
 *
 * Copyright (c) 2024 Ayush Singh <ayush@beagleboard.org>
 */

/ {
	zephyr,user {
		io-channels = <&adc0 0>;
	};
};

&adc0 {
	status = "okay";

	#address-cells = <1>;
	#size-cells = <0>;

	channel@0 {
		reg = <0>;
		zephyr,gain = "ADC_GAIN_1";
		zephyr,reference = "ADC_REF_INTERNAL";
		zephyr,acquisition-time = <ADC_ACQ_TIME_DEFAULT>;
		zephyr,resolution = <12>;
	};
};
