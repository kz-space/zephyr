## boards/sparkfun/micromod/Kconfig.nrf52840
```kconfig
# Sparkfun micromod/nRF52840 board configuration

# Copyright (c) 2024 Jerónimo Agulló <jeronimoagullo97@gmail.com>
# SPDX-License-Identifier: Apache-2.0

config BOARD_ENABLE_DCDC
	bool "DCDC mode"
	select SOC_DCDC_NRF52X
	default y

config BOARD_ENABLE_DCDC_HV
	bool "High Voltage DCDC converter"
	select SOC_DCDC_NRF52X_HV
	default y
	depends on SOC_NRF52840_QIAA

config BT_CTLR
	default BT
```

## drivers/led/Kconfig.lp5521
```kconfig
# Copyright (c) 2024 Croxel, Inc.
# SPDX-License-Identifier: Apache-2.0
config LP5521
	bool "LP5521 LED driver"
	default y
	depends on DT_HAS_TI_LP5521_ENABLED
	select I2C
	help
	  Enable LED driver for LP5521.

	  LP5521 LED driver has 3 channels (RGB). Each channel can drive up to
	  25.5 mA per LED.
```

## dts/bindings/led_strip/worldsemi,ws2812-uart.yaml
```yaml
# Copyright (c) 2024 Croxel, Inc.
# SPDX-License-Identifier: Apache-2.0

description: |
  Worldsemi WS2812 LED strip, UART binding

  Driver bindings for controlling a WS2812 or compatible LED
  strip with a UART.

  The UART driver should be usable as long as a zephyr UART API driver is available for your
  board and has tx-invert property available and enabled.
  Hardware specific tuning is required using these properties:

    - uart-baudrate
    - data-bits

  Data serialisation explanation for WS2812:
  3 pulses/bits of UART are used to represent one bit of RGB data. During the development of this
  driver, I was using an ESP32C3 MCU with its UART baud rate set to 2.5Mbits per sec. Hence, 1
  bit equals 400ns. For WS2812 timing details, please refer to its datasheet.
  Link: https://cdn-shop.adafruit.com/datasheets/WS2812.pdf
  We can represent logic 1 with 0b110 (first two bits high, remaining one bit low), and logic
  0 with 0b100 (first bit high, remaining two bits low). We also need to invert the polarity
  of UART pins because in default, the idle TX line is high, but WS2812 or similar LEDs need
  the idle line to be low, otherwise, it will misinterpret. When we make the TX line inverted,
  the start bit will be low to high and the stop bit will be high to low. Hence, the nine bits
  we are sending in one go will always have 1 at the start and 0 at the end, we just need to
  calculate middle 7 bits. Also, keep in mind that UART always sends the MSB first. Keeping all
  this data in mind, I created a lookup table to ease the calculations.

compatible: "worldsemi,ws2812-uart"

include: [uart-controller.yaml, ws2812.yaml]

properties:
  bits-per-rgb-bit:
    type: int
    required: true
    description: |
      Total number of bits representing single RGB data bit.

  lookup-table:
    type: array
    required: true
    description: |
      Lookup data that will be used to encode
      RGB data bits into UART streams.

      For example, when setting this driver for WS2812, used 7 UART data bits and 3 bits
      to represent single RGB data bit, below table was used:
      lookup-table = <0x5B 0x1B 0x53 0x13 0x5A 0x1A 0x52 0x12>;
```

## dts/bindings/rtc/microcrystal,rv-8263-c8.yaml
```yaml
# SPDX-License-Identifier: Apache-2.0
# Copyright (c) 2024 Daniel Kampert
# Author: Daniel Kampert <DanielKampert@Kampis-Elektroecke.de>

description: Micro Crystal RV-8263-C8 RTC

compatible: "microcrystal,rv-8263-c8"

include:
  - name: rtc-device.yaml
  - name: i2c-device.yaml

properties:
  int-gpios:
    type: phandle-array

  clkout:
    type: int
    enum:
      - 32768
      - 8192
      - 1024
      - 64
      - 32
      - 1
    description:
      Enable CLKOUT at given frequency. When disabled, CLKOUT pin is LOW.
```

## samples/bluetooth/handsfree_ag/boards/mimxrt1170_evk_mimxrt1176_cm7_B.conf
```kconfig
#select NXP BT controller
CONFIG_BT_H4_NXP_CTLR=y
#select NXP NW612 Chipset
CONFIG_BT_NXP_NW612=y
```

## samples/boards/nrf/dmm/sample.yaml
```yaml
sample:
  name: dmm use example
tests:
  sample.boards.nrf.dmm:
    platform_allow:
      - nrf52840dk/nrf52840
      - nrf5340dk/nrf5340/cpuapp
      - nrf54h20dk/nrf54h20/cpuapp
    integration_platforms:
      - nrf52840dk/nrf52840
      - nrf5340dk/nrf5340/cpuapp
      - nrf54h20dk/nrf54h20/cpuapp
    tags: board
    harness: console
    harness_config:
      type: multi_line
      ordered: true
      regex:
        - "DMM sample start"
        - "Memory region: 0x(.*). User buffer address: 0x(.*)"
        - "Output buffer=0x(.*)"
        - "Input buffer=0x(.*)"
        - "Memory region: 0x(.*). User buffer address: 0x(.*)"
        - "Output buffer=0x(.*)"
        - "Input buffer=0x(.*)"
```

## samples/boards/stm32/i2c_timing/sample.yaml
```yaml
sample:
  name: STM32 I2C V2 timing
tests:
  sample.boards.stm32.i2c_timing:
    depends_on: i2c
    tags:
      - drivers
      - i2c
    filter: dt_compat_enabled("st,stm32-i2c-v2")
    platform_allow: nucleo_l476rg nucleo_wb55rg b_u585i_iot02a
    harness: console
    harness_config:
      type: multi_line
      regex:
        - "I2C timing value, report to the DTS :"
        - "timings = *"
        - "I2C freq. I2C_BITRATE_*"
```

## samples/subsys/video/capture/sample.yaml
```yaml
sample:
  name: Video capture
tests:
  sample.video.capture:
    build_only: true
    tags:
      - video
      - shield
      - samples
    depends_on:
      - video
    extra_args:
      - platform:mimxrt1064_evk:SHIELD=dvp_fpc24_mt9m114
      - platform:mimxrt1170_evk/mimxrt1176/cm7:SHIELD="nxp_btb44_ov5640;rk055hdmipi4ma0"
    platform_allow:
      - mimxrt1064_evk
      - mimxrt1170_evk/mimxrt1176/cm7
      - mm_swiftio
    integration_platforms:
      - mimxrt1064_evk
      - mimxrt1170_evk/mimxrt1176/cm7
```

## tests/bluetooth/bt_crypto/testcase.yaml
```yaml
common:
  platform_allow:
    - native_posix
    - native_posix/native/64
    - native_sim
    - native_sim/native/64
    - qemu_x86
    - qemu_cortex_m3
    - nrf9160dk/nrf9160/ns
  integration_platforms:
    - native_sim

tests:
  bluetooth.bt_crypto:
    tags: bluetooth
  bluetooth.bt_crypto.psa:
    filter: CONFIG_BUILD_WITH_TFM
    extra_configs:
      - CONFIG_BT_USE_PSA_API=y
    tags: bluetooth
```

## tests/bluetooth/gatt/testcase.yaml
```yaml
common:
  platform_allow:
    - native_posix
    - native_posix/native/64
    - native_sim
    - native_sim/native/64
    - qemu_x86
    - qemu_cortex_m3
    - nrf9160dk/nrf9160/ns
  integration_platforms:
    - native_sim

tests:
  bluetooth.gatt:
    tags:
      - bluetooth
      - gatt
  bluetooth.gatt.psa:
    filter: CONFIG_BUILD_WITH_TFM
    extra_configs:
      - CONFIG_BT_USE_PSA_API=y
    tags:
      - bluetooth
      - gatt
```

## tests/bluetooth/hci/testcase.yaml
```yaml
tests:
  bluetooth.hci:
    integration_platforms:
      - native_sim
    tags:
      - bluetooth
```

## tests/drivers/can/api/boards/imx93_evk_mimx9352_a55.conf
```kconfig
# Copyright 2024 NXP
# SPDX-License-Identifier: Apache-2.0

CONFIG_I2C=y
CONFIG_MFD=y
CONFIG_GPIO=y
CONFIG_GPIO_HOGS=y
```

## tests/drivers/gpio/gpio_basic_api/testcase.yaml
```yaml
common:
  tags:
    - drivers
    - gpio
  depends_on: gpio
  harness: ztest
  harness_config:
    fixture: gpio_loopback

tests:
  drivers.gpio.2pin:
    min_flash: 34
    filter: dt_compat_enabled("test-gpio-basic-api")

  drivers.gpio.nrf_sense_edge:
    platform_allow: nrf52840dk/nrf52840 nrf52_bsim
    extra_args: "DTC_OVERLAY_FILE=boards/nrf52840dk_nrf52840.overlay;\
                 boards/nrf52840dk_nrf52840_sense_edge.overlay"

  drivers.gpio.mr_canhubk3_wkpu:
    platform_allow: mr_canhubk3
    extra_args: "DTC_OVERLAY_FILE=boards/mr_canhubk3_wkpu.overlay"

  drivers.gpio.2pin.nrf54h20dk_nrf54h20_cpuppr:
    tags:
      - drivers
      - gpio
    depends_on: gpio
    # Fix exclude when we can exclude just sim run
    platform_allow:
      - nrf54h20dk/nrf54h20/cpuppr
    sysbuild: true
    extra_configs:
      - vpr_launcher_CONFIG_NRF_REGTOOL_EXTRA_GENERATE_ARGS="-i ../../../tests/drivers/gpio/gpio_basic_api/boards/nrf54h20dk_nrf54h20_vpr_launcher.toml"
      # Disable asserts to fit in limited code memory
      - CONFIG_ASSERT=n
      - vpr_launcher_CONFIG_NRF_REGTOOL_VERBOSITY=2
    extra_args:
      - vpr_launcher_DTC_OVERLAY_FILE="../../../tests/drivers/gpio/gpio_basic_api/boards/nrf54h20dk_nrf54h20_vpr_launcher.overlay"
      - SB_CONFIG_VPR_LAUNCHER=y
```

## tests/drivers/uart/uart_emul/testcase.yaml
```yaml
common:
  tags:
    - drivers
    - uart
  harness: ztest
tests:
  drivers.uart.emul.polling:
    platform_allow:
      - qemu_x86
      - native_sim
    extra_args: DTC_OVERLAY_FILE="uart_emul.overlay"
  drivers.uart.emul.interrupt_driven:
    platform_allow:
      - qemu_x86
      - native_sim
    extra_configs:
      - CONFIG_UART_INTERRUPT_DRIVEN=y
    extra_args: DTC_OVERLAY_FILE="uart_emul.overlay"
  drivers.uart.emul.async:
    platform_allow:
      - qemu_x86
      - native_sim
    extra_configs:
      - CONFIG_EVENTS=y
      - CONFIG_UART_ASYNC_API=y
    extra_args: DTC_OVERLAY_FILE="uart_emul.overlay"
```

## tests/kernel/ipi_cascade/testcase.yaml
```yaml
tests:
  kernel.ipi_cascade.smp:
    tags:
      - kernel
      - smp
    filter: CONFIG_SMP and (CONFIG_MP_MAX_NUM_CPUS > 1)
```
